## board/freescale/t66/Kconfig
```kconfig
if TARGET_T66

config SYS_CPU
	default "armv7"

config SYS_BOARD
	default "t66"

config SYS_VENDOR
	default "freescale"

config SYS_SOC
	default "mx6"

config SYS_CONFIG_NAME
	default "t66"

endif
```

## configs/t66_defconfig
```kconfig
CONFIG_SYS_EXTRA_OPTIONS="IMX_CONFIG=board/freescale/t66/mx6q_4x_mt41j128.cfg,MX6Q"
CONFIG_ARM=y
CONFIG_TARGET_T66=y
```
